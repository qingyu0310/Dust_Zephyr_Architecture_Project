## thread/Kconfig
```kconfig
# Application thread and feature configuration.

rsource "../../drivers/Kconfig"
rsource "../../algorithm/Kconfig"
rsource "../../modules/Kconfig"
rsource "../../topic/Kconfig"

# ============================================================================

config TRD_GPIO
    bool "GPIO thread task"
    default y
    select DEV_GPIO_OUTPUT
    select CTL_TIMER
    help
      Enable the GPIO/output indicator thread.

# ============================================================================

config TRD_CHASSIS
    bool "Chassis control thread"
    default n
    select MOD_CTL_POWER
    select MOD_DEV_MOTOR_DJI
    select TPC_TO_CAN_TX
    select TPC_REMOTE_TO
    help
      Enable chassis control thread.

config USE_POWERMETER
    bool "Power meter"
    depends on TRD_CHASSIS
    default n
    select MOD_DEV_POWERMETER
    help
      Enable power meter support for chassis control.

# ============================================================================

config TRD_GIMBAL
    bool "Gimbal control thread"
    default n
    select CTL_PID
    select MOD_DEV_MOTOR_DM
    select TPC_TO_CAN_TX
    select TPC_REMOTE_TO
    help
      Enable gimbal control thread.

# ============================================================================

config TRD_CAN_TX
    bool "CAN TX thread"
    default y
    select COM_CAN
    select TPC_TO_CAN_TX
    help
      Enable CAN TX thread.

# ============================================================================

config TRD_REMOTE
    bool "Remote thread"
    default n
    select MOD_DEV_REMOTE
    help
      Enable remote receiver thread.

# ============================================================================

config TRD_IMU
    bool "IMU thread"
    default n
    select MOD_DEV_IMU
    select TPC_IMU_TO
    help
      Enable IMU acquisition, heater control, and publish thread.

config IMU_IDENTIFICATION
    bool "IMU heater identification"
    default n
    depends on TRD_IMU
    select MOD_DEV_IMU_IDENT
    help
      IMU heater open-loop identification, replaces PID closed-loop control.

# ============================================================================

config TRD_TFLM
    bool "TFLM inference thread"
    default n
    select TFLM
    help
      Enable TFLM inference test thread.

# ============================================================================

config TRD_PC
    bool "PC communication thread"
    default n
    select COM_USB
    help
      PC communication thread (USB CDC ACM loopback test).

# ============================================================================

config TRD_TEST
    bool "User test add config"
    default y
    select COM_UART_DMA
    select MOD_DEV_MOTOR_DM
    select CTL_PID
    select TPC_TO_CAN_TX
    help
      Temporary user test switch.

# ============================================================================
```
